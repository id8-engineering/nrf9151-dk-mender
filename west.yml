## west.yml
```yaml
# Copyright (c) 2026 ID8 Engineering AB
# SPDX-License-Identifier: Apache-2.0

manifest:
  self:
    west-commands: scripts/west-commands.yml

  remotes:
    - name: ncs
      url-base: https://github.com/nrfconnect

  projects:
    - name: nrf
      remote: ncs
      repo-path: sdk-nrf
      revision: v3.2.1
      import: true

    - name: mender-mcu
      url: https://github.com/mendersoftware/mender-mcu
      revision: 20e13a429355e7b38381e4ed182ebff603fcf4a9
      path: modules/mender-mcu
```
